/*
* Oryginal by:
* Author : Aaron Lee
* Version: 1.00
* Date   : 2014.3.24
* Email  : hello14blog@gmail.com
* Modification: none
* Mod by reaper7
* found at http://bbs.espressif.com/viewtopic.php?f=15&t=31
*/

// Hackishly modified to support (only?) 128x32 pixel I2C OLED displays
// with great inspiration from the Adafruit Arduino driver.

#include "i2c.h"
#include "i2c_oled.h"
#include "i2c_oled_fonts.h"
#include "osapi.h"

#define MAX_SMALL_FONTS 21 //SMALL FONTS
#define MAX_BIG_FONTS 16 //BIG FONTS

void ICACHE_FLASH_ATTR OLED_Display(void);


static uint8_t buffer[SSD1306_LCDHEIGHT * SSD1306_LCDWIDTH / 8] = { 
0x00, 0x00, 0x00, 0x00, 0x00, 0x00, 0x00, 0x00, 0x00, 0x00, 0x00, 0x00, 0x00, 0x00, 0x00, 0x00,
0x00, 0x00, 0x00, 0x00, 0x00, 0x00, 0x00, 0x00, 0x00, 0x00, 0x00, 0x00, 0x00, 0x00, 0x00, 0x00,
0x00, 0x00, 0x00, 0x00, 0x00, 0x00, 0x00, 0x00, 0x00, 0x00, 0x00, 0x00, 0x00, 0x00, 0x00, 0x00,
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0x80, 0x80, 0x00, 0x80, 0x80, 0x00, 0x00, 0x00, 0x00, 0x80, 0x80, 0x80, 0x80, 0x80, 0x00, 0xFF,
#if (SSD1306_LCDHEIGHT * SSD1306_LCDWIDTH > 96*16)
0xFF, 0xFF, 0x00, 0x00, 0x00, 0x00, 0x80, 0x80, 0x80, 0x80, 0x00, 0x00, 0x80, 0x80, 0x00, 0x00,
0x80, 0xFF, 0xFF, 0x80, 0x80, 0x00, 0x80, 0x80, 0x00, 0x80, 0x80, 0x80, 0x80, 0x00, 0x80, 0x80,
0x00, 0x00, 0x00, 0x00, 0x00, 0x80, 0x80, 0x00, 0x00, 0x8C, 0x8E, 0x84, 0x00, 0x00, 0x80, 0xF8,
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0x03, 0x01, 0x00, 0x00, 0x00, 0x00, 0x00, 0x00, 0x00, 0x00, 0x00, 0x00, 0x00, 0x00, 0x00, 0x00,
#if (SSD1306_LCDHEIGHT == 64)
0x00, 0x00, 0x00, 0x80, 0xC0, 0xE0, 0xF0, 0xF9, 0xFF, 0xFF, 0xFF, 0xFF, 0xFF, 0x3F, 0x1F, 0x0F,
0x87, 0xC7, 0xF7, 0xFF, 0xFF, 0x1F, 0x1F, 0x3D, 0xFC, 0xF8, 0xF8, 0xF8, 0xF8, 0x7C, 0x7D, 0xFF,
0xFF, 0xFF, 0xFF, 0xFF, 0xFF, 0xFF, 0xFF, 0x7F, 0x3F, 0x0F, 0x07, 0x00, 0x30, 0x30, 0x00, 0x00,
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0x00, 0x00, 0x00, 0x00, 0x00, 0x00, 0x00, 0x00, 0x00, 0x00, 0x00, 0x00, 0x00, 0x00, 0x00, 0x00
#endif
#endif
};


static bool oledstat = false;

bool ICACHE_FLASH_ATTR
OLED_writeReg(uint8_t reg_addr,uint8_t val)
{
  i2c_start();
  i2c_writeByte(OLED_ADDRESS);
  if(!i2c_check_ack()) {
    i2c_stop();
    return 0;
  }
  i2c_writeByte(reg_addr);
  if(!i2c_check_ack()) {
    i2c_stop();
    return 0;
  }
  i2c_writeByte(val&0xff);
  if(!i2c_check_ack()) {
    i2c_stop();
    return 0;
  }
  i2c_stop();
  
  if (reg_addr==0x00)
    oledstat=true;
    
  return 1;
}

void ICACHE_FLASH_ATTR
ssd1306_command(unsigned char I2C_Command)
{
  OLED_writeReg(0x00,I2C_Command);
}

void ICACHE_FLASH_ATTR
OLED_writeDat(unsigned char I2C_Data)
{
	OLED_writeReg(0x40,I2C_Data);
}


void ICACHE_FLASH_ATTR OLED_drawPixel(int16_t x, int16_t y, uint16_t color) {
  int rotation = 0;
  if ((x < 0) || (x >= SSD1306_LCDWIDTH) || (y < 0) || (y >= SSD1306_LCDHEIGHT))
    return;

  // check rotation, move pixel around if necessary
  switch (rotation) {
  case 1:
    swap(x, y);
    x = SSD1306_LCDWIDTH - x - 1;
    break;
  case 2:
    x = SSD1306_LCDWIDTH - x - 1;
    y = SSD1306_LCDHEIGHT - y - 1;
    break;
  case 3:
    swap(x, y);
    y = SSD1306_LCDHEIGHT - y - 1;
    break;
  }  

  // x is which column
    switch (color) 
    {
      case WHITE:   buffer[x+ (y/8)*SSD1306_LCDWIDTH] |=  (1 << (y&7)); break;
      case BLACK:   buffer[x+ (y/8)*SSD1306_LCDWIDTH] &= ~(1 << (y&7)); break; 
      case INVERSE: buffer[x+ (y/8)*SSD1306_LCDWIDTH] ^=  (1 << (y&7)); break; 
    }
    
}

void ICACHE_FLASH_ATTR OLED_Blit8(unsigned char x, unsigned char y, unsigned char b)
{
  buffer[x+ (y/8)*SSD1306_LCDWIDTH] = b;
}


bool ICACHE_FLASH_ATTR
OLED_Init(void)
{

  int vccstate = SSD1306_SWITCHCAPVCC;

	os_delay_us(60000);
	os_delay_us(40000);
  // Init sequence for 128x32 OLED module
  ssd1306_command(SSD1306_DISPLAYOFF);                    // 0xAE
  ssd1306_command(SSD1306_SETDISPLAYCLOCKDIV);            // 0xD5
  ssd1306_command(0x80);                                  // the suggested ratio 0x80
  ssd1306_command(SSD1306_SETMULTIPLEX);                  // 0xA8
  ssd1306_command(0x1F);
  ssd1306_command(SSD1306_SETDISPLAYOFFSET);              // 0xD3
  ssd1306_command(0x0);                                   // no offset
  ssd1306_command(SSD1306_SETSTARTLINE | 0x0);            // line #0
  ssd1306_command(SSD1306_CHARGEPUMP);                    // 0x8D
  if (vccstate == SSD1306_EXTERNALVCC) 
    { ssd1306_command(0x10); }
  else 
    { ssd1306_command(0x14); }
  ssd1306_command(SSD1306_MEMORYMODE);                    // 0x20
  ssd1306_command(0x00);                                  // 0x0 act like ks0108
  ssd1306_command(SSD1306_SEGREMAP | 0x1);
  ssd1306_command(SSD1306_COMSCANDEC);
  ssd1306_command(SSD1306_SETCOMPINS);                    // 0xDA
  ssd1306_command(0x02);
  ssd1306_command(SSD1306_SETCONTRAST);                   // 0x81
  ssd1306_command(0x8F);
  ssd1306_command(SSD1306_SETPRECHARGE);                  // 0xd9
  if (vccstate == SSD1306_EXTERNALVCC) 
    { ssd1306_command(0x22); }
  else 
    { ssd1306_command(0xF1); }
  ssd1306_command(SSD1306_SETVCOMDETECT);                 // 0xDB
  ssd1306_command(0x40);
  ssd1306_command(SSD1306_DISPLAYALLON_RESUME);           // 0xA4
  ssd1306_command(SSD1306_NORMALDISPLAY);                 // 0xA6

  ssd1306_command(SSD1306_DISPLAYON);//--turn on oled panel

  OLED_ClearBuffer();
//  OLED_Fill(0x00);  //OLED CLS
  OLED_Display();

  return oledstat;
}

void ICACHE_FLASH_ATTR OLED_Display(void) {
  uint16_t i;
  uint8_t x;
  ssd1306_command(SSD1306_COLUMNADDR);
  ssd1306_command(0);   // Column start address (0 = reset)
  ssd1306_command(SSD1306_LCDWIDTH-1); // Column end address (127 = reset)

  ssd1306_command(SSD1306_PAGEADDR);
  ssd1306_command(0); // Page start address (0 = reset)
  #if SSD1306_LCDHEIGHT == 64
    ssd1306_command(7); // Page end address
  #endif
  #if SSD1306_LCDHEIGHT == 32
    ssd1306_command(3); // Page end address
  #endif
  #if SSD1306_LCDHEIGHT == 16
    ssd1306_command(1); // Page end address
  #endif

  // I2C
  for (i=0; i<(SSD1306_LCDWIDTH*SSD1306_LCDHEIGHT/8); i++) {
    // send a bunch of data in one xmission
    i2c_start(); // Wire.beginTransmission(_i2caddr);
    i2c_writeByte(OLED_ADDRESS);
#if 1
    if(!i2c_check_ack()) {
      i2c_stop();
      return;
    }
#endif
    i2c_writeByte(0x40); // WIRE_WRITE(0x40);
#if 1
    if(!i2c_check_ack()) {
      i2c_stop();
      return;
    }
#endif
    for (x=0; x<16; x++) {
      i2c_writeByte(buffer[i]); // WIRE_WRITE(buffer[i]);
#if 1
      if(!i2c_check_ack()) {
        i2c_stop();
        return;
      }
#endif
      i++;
    }
    i--;
    i2c_stop(); // Wire.endTransmission();
  }
}

void ICACHE_FLASH_ATTR
OLED_SetPos(unsigned char x, unsigned char y)
{ 
	ssd1306_command(0xb0+y);
	ssd1306_command(((x&0xf0)>>4)|0x10);
	ssd1306_command((x&0x0f)|0x01);
}

void ICACHE_FLASH_ATTR
OLED_Fill(unsigned char fill_Data)
{
	unsigned char m,n;
	for(m=0;m<8;m++)
	{
		ssd1306_command(0xb0+m);		//page0-page1
		ssd1306_command(0x00);		//low column start address
		ssd1306_command(0x10);		//high column start address
		for(n=0;n<132;n++)
			{
				OLED_writeDat(fill_Data);
			}
	}
}

void ICACHE_FLASH_ATTR
OLED_CLS(void)
{
	OLED_Fill(0x00);
}

void ICACHE_FLASH_ATTR
OLED_ON(void)
{
	ssd1306_command(0X8D);
	ssd1306_command(0X14);
	ssd1306_command(0XAF);
}

void ICACHE_FLASH_ATTR
OLED_OFF(void)
{
	ssd1306_command(0X8D);
	ssd1306_command(0X10);
	ssd1306_command(0XAE);
}

void ICACHE_FLASH_ATTR
OLED_ShowStr(unsigned char x, unsigned char y, unsigned char ch[], unsigned char TextSize)
{
	unsigned char c = 0,i = 0,j = 0;
	switch(TextSize)
	{
		case 1:
		{
			while(ch[j] != '\0')
			{
				c = ch[j] - 32;
				if(x > 126)
				{
					x = 0;
					y++;
				}
				OLED_SetPos(x,y);
				for(i=0;i<6;i++)
					OLED_writeDat(F6x8[c][i]);
				x += 6;
				j++;
			}
		}break;
		case 2:
		{
			while(ch[j] != '\0')
			{
				c = ch[j] - 32;
				if(x > 120)
				{
					x = 0;
					y++;
				}
				OLED_SetPos(x,y);
				for(i=0;i<8;i++)
					OLED_writeDat(F8X16[c*16+i]);
				OLED_SetPos(x,y+1);
				for(i=0;i<8;i++)
					OLED_writeDat(F8X16[c*16+i+8]);
				x += 8;
				j++;
			}
		}break;
	}
}

void ICACHE_FLASH_ATTR
OLED_Print(unsigned char x, unsigned char y, unsigned char ch[], unsigned char TextSize)
{
  uint8_t step;
  if (TextSize==1)
    step = x*6; 
  else if (TextSize==2)
    step = x*8; 
  else 
    step = x;
  OLED_ShowStr(step,y,ch,TextSize);
}

void ICACHE_FLASH_ATTR
OLED_Line(unsigned char y, unsigned char ch[], unsigned char TextSize)
{
  uint8 step;
  uint8 len = strlen(ch);
  uint8 maxf = 0;
  
  y--;
  
  if (TextSize==1) { 
    maxf = MAX_SMALL_FONTS;
  }
  else if (TextSize==2) {
    y *= 2;
    maxf = MAX_BIG_FONTS;
  }

  if ((TextSize>=1) && (TextSize<=2)) {
    os_memset(ch+len+1,' ',maxf-len);
    os_memset(ch+maxf,'\0',1);

    OLED_ShowStr(0,y,ch,TextSize);
  }
}

/*
void ICACHE_FLASH_ATTR
OLED_DrawBMP(unsigned char x0,unsigned char y0,unsigned char x1,unsigned char y1,unsigned char BMP[])
{
	unsigned int j=0;
	unsigned char x,y;

  if(y1%8==0)
		y = y1/8;
  else
		y = y1/8 + 1;
	for(y=y0;y<y1;y++)
	{
		OLED_SetPos(x0,y);
    for(x=x0;x<x1;x++)
		{
			OLED_writeDat(BMP[j++]);
		}
	}
}
*/

// Silly-blit and display the BMP
// Note: the width must be a multiple of 8
void ICACHE_FLASH_ATTR OLED_SillyDrawBMP(unsigned char x, unsigned char y, unsigned char w, unsigned char h, unsigned char *bmp)
{
  unsigned int i, j;
  for (j=0; j<h; j++) {
    for(i=0; i<w/8; i++) {
      unsigned char b = *(bmp++);
      OLED_drawPixel(x+8*i+0, y+j, (b & 1) ? WHITE : BLACK);  b >>= 1;
      OLED_drawPixel(x+8*i+1, y+j, (b & 1) ? WHITE : BLACK);  b >>= 1;
      OLED_drawPixel(x+8*i+2, y+j, (b & 1) ? WHITE : BLACK);  b >>= 1;
      OLED_drawPixel(x+8*i+3, y+j, (b & 1) ? WHITE : BLACK);  b >>= 1;
      OLED_drawPixel(x+8*i+4, y+j, (b & 1) ? WHITE : BLACK);  b >>= 1;
      OLED_drawPixel(x+8*i+5, y+j, (b & 1) ? WHITE : BLACK);  b >>= 1;
      OLED_drawPixel(x+8*i+6, y+j, (b & 1) ? WHITE : BLACK);  b >>= 1;
      OLED_drawPixel(x+8*i+7, y+j, (b & 1) ? WHITE : BLACK);
    }
  }
}

void ICACHE_FLASH_ATTR OLED_SillyDrawPartialBMP(unsigned char x, unsigned char y, unsigned char w, unsigned char h, unsigned char x_skip, unsigned char bmp_w, unsigned char *bmp)
{
  unsigned int i, j;
  for (j=0; j<h; j++) {
    bmp += (x_skip/8);
    for(i=0; i<w/8; i++) {
      unsigned char b = *(bmp++);
      OLED_drawPixel(x+8*i+0, y+j, (b & 1) ? WHITE : BLACK);  b >>= 1;
      OLED_drawPixel(x+8*i+1, y+j, (b & 1) ? WHITE : BLACK);  b >>= 1;
      OLED_drawPixel(x+8*i+2, y+j, (b & 1) ? WHITE : BLACK);  b >>= 1;
      OLED_drawPixel(x+8*i+3, y+j, (b & 1) ? WHITE : BLACK);  b >>= 1;
      OLED_drawPixel(x+8*i+4, y+j, (b & 1) ? WHITE : BLACK);  b >>= 1;
      OLED_drawPixel(x+8*i+5, y+j, (b & 1) ? WHITE : BLACK);  b >>= 1;
      OLED_drawPixel(x+8*i+6, y+j, (b & 1) ? WHITE : BLACK);  b >>= 1;
      OLED_drawPixel(x+8*i+7, y+j, (b & 1) ? WHITE : BLACK);
    }
    bmp += ((bmp_w - w - x_skip)/8);
  }
}

void ICACHE_FLASH_ATTR OLED_ClearBuffer()
{
  os_memset(buffer, 0x00, (SSD1306_LCDWIDTH*SSD1306_LCDHEIGHT/8));
}
